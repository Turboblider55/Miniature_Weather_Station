## src/blink/main/Kconfig.projbuild
```kconfig
menu "Weather Station Config"

    orsource "$IDF_PATH/examples/common_components/env_caps/$IDF_TARGET/Kconfig.env_caps"

    choice BLINK_LED
        prompt "Blink LED type"
        default BLINK_LED_GPIO
        help
            Select the LED type. A normal level controlled LED or an addressable LED strip.
            The default selection is based on the Espressif DevKit boards.
            You can change the default selection according to your board.

        config BLINK_LED_GPIO
            bool "GPIO"
        config BLINK_LED_STRIP
            bool "LED strip"
    endchoice

    choice BLINK_LED_STRIP_BACKEND
        depends on BLINK_LED_STRIP
        prompt "LED strip backend peripheral"
        default BLINK_LED_STRIP_BACKEND_RMT if SOC_RMT_SUPPORTED
        default BLINK_LED_STRIP_BACKEND_SPI
        help
            Select the backend peripheral to drive the LED strip.

        config BLINK_LED_STRIP_BACKEND_RMT
            depends on SOC_RMT_SUPPORTED
            bool "RMT"
        config BLINK_LED_STRIP_BACKEND_SPI
            bool "SPI"
    endchoice

    config BLINK_GPIO
        int "Blink GPIO number"
        range ENV_GPIO_RANGE_MIN ENV_GPIO_OUT_RANGE_MAX
        default 8
        help
            GPIO number (IOxx) to blink on and off the LED.
            Some GPIOs are used for other purposes (flash connections, etc.) and cannot be used to blink.

    config BLINK_PERIOD
        int "Blink period in ms"
        range 10 3600000
        default 1000
        help
            Define the blinking period in milliseconds.

    config SUPABASE_API_KEY
        string "Supabase API key for measurements endpoint"
        default "sb_publishable_47ApWRf7T1esYfIBUWkRGg_VVbAVhp3"
        help
            Supabase API key for measurements endpoint. Must be a publishable key with insert permissions on the measurements table.

    config SUPABASE_URL
        string "Supabase URL for measurements endpoint"
        default "https://hzucoiipjnfhnqjxtrgj.supabase.co/rest/v1"
        help
            Supabase URL for measurements endpoint.

    config WIFI_SSID
        string "WiFi SSID to connect to"
        default "Cudy-A64C"
        help
            WiFi SSID for the network to connect to.

    config WIFI_PASSWORD
        string "WiFi password to connect to"
        default 99957902
        help
            WiFi password for the network to connect to.
    
    config STATION_NAME
        string "Station name to register in the database"
        default "MainWeatherStation"
        help
            The name of the station to register in the database. This should match a station name in your stations table.

endmenu
```
